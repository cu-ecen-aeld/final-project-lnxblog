## base_external/package/aesd-char-driver/Config.in
```kconfig
config BR2_PACKAGE_AESD_CHAR_DRIVER
	bool "aesd-char-driver"
	depends on BR2_LINUX_KERNEL
	help
	  Includes the aesd char driver.
	  Used to understand buildroot external trees and package builds.
	  
```

## base_external/package/ldd/Config.in
```kconfig
config BR2_PACKAGE_LDD
	bool "ldd"
	depends on BR2_LINUX_KERNEL
	help
	  Includes the ldd kernel modules in the kernel image.
	  Used to understand buildroot external trees and package builds.
	  
```
